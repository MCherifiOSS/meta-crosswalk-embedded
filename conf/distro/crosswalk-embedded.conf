## conf/distro/crosswalk-embedded.conf
```bitbake
# Distribution definition for: crosswalk-embedded
#
# Copyright (c) 2014, Intel Corporation.
# All rights reserved.

require conf/distro/poky.conf

DISTRO = "crosswalk-embedded"

POKY_DEFAULT_DISTRO_FEATURES = ""
POKY_DEFAULT_EXTRA_RDEPENDS += "packagegroup-core-boot"
POKY_DEFAULT_EXTRA_RRECOMMENDS = ""

PREFERRED_VERSION_linux-yocto = "3.17%"

DISTRO_FEATURES = "\
    ${DISTRO_FEATURES_LIBC_DEFAULT} \
    alsa \
    ipv4 \
    opengl \
    pci \
    usbhost \
    wifi \
    "

# Bootloader appends
APPEND = "i915.fastboot=1"

IMAGE_FSTYPES = "hddimg"

INHERIT += "blacklist"
PNBLACKLIST[build-appliance-image] = "not buildable with crosswalk-embedded"
PNBLACKLIST[core-image-base] = "not buildable with crosswalk-embedded"
PNBLACKLIST[core-image-clutter] = "not buildable with crosswalk-embedded"
PNBLACKLIST[core-image-directfb] = "not buildable with crosswalk-embedded"
PNBLACKLIST[core-image-full-cmdline] = "not buildable with crosswalk-embedded"
PNBLACKLIST[core-image-lsb] = "not buildable with crosswalk-embedded"
PNBLACKLIST[core-image-lsb-dev] = "not buildable with crosswalk-embedded"
PNBLACKLIST[core-image-lsb-sdk] = "not buildable with crosswalk-embedded"
PNBLACKLIST[core-image-rt] = "not buildable with crosswalk-embedded"
PNBLACKLIST[core-image-rt-sdk] = "not buildable with crosswalk-embedded"
PNBLACKLIST[core-image-sato] = "not buildable with crosswalk-embedded"
PNBLACKLIST[core-image-sato-dev] = "not buildable with crosswalk-embedded"
PNBLACKLIST[core-image-sato-sdk] = "not buildable with crosswalk-embedded"
PNBLACKLIST[core-image-x11] = "not buildable with crosswalk-embedded"
PNBLACKLIST[qt4e-demo-image] = "not buildable with crosswalk-embedded"
PNBLACKLIST[core-image-weston] = "not buildable with crosswalk-embedded"
```

## conf/distro/lakebodom.conf
```bitbake
# Distribution definition for: lakebodom
#
# Copyright (c) 2014, Intel Corporation.
# All rights reserved.

require conf/distro/poky.conf

DISTRO = "lakebodom"

POKY_DEFAULT_DISTRO_FEATURES = ""
POKY_DEFAULT_EXTRA_RDEPENDS += "packagegroup-core-boot"
POKY_DEFAULT_EXTRA_RRECOMMENDS = ""

DISTRO_FEATURES = "\
    ${DISTRO_FEATURES_LIBC_DEFAULT} \
    3g \
    alsa \
    bluetooth \
    ipv4 \
    opengl \
    pci \
    usbhost \
    wifi \
    "

IMAGE_FSTYPES = "hddimg"

INHERIT += "blacklist"
PNBLACKLIST[build-appliance-image] = "not buildable with lakebodom"
PNBLACKLIST[core-image-base] = "not buildable with lakebodom"
PNBLACKLIST[core-image-clutter] = "not buildable with lakebodom"
PNBLACKLIST[core-image-directfb] = "not buildable with lakebodom"
PNBLACKLIST[core-image-full-cmdline] = "not buildable with lakebodom"
PNBLACKLIST[core-image-lsb] = "not buildable with lakebodom"
PNBLACKLIST[core-image-lsb-dev] = "not buildable with lakebodom"
PNBLACKLIST[core-image-lsb-sdk] = "not buildable with lakebodom"
PNBLACKLIST[core-image-rt] = "not buildable with lakebodom"
PNBLACKLIST[core-image-rt-sdk] = "not buildable with lakebodom"
PNBLACKLIST[core-image-sato] = "not buildable with lakebodom"
PNBLACKLIST[core-image-sato-dev] = "not buildable with lakebodom"
PNBLACKLIST[core-image-sato-sdk] = "not buildable with lakebodom"
PNBLACKLIST[core-image-x11] = "not buildable with lakebodom"
PNBLACKLIST[qt4e-demo-image] = "not buildable with lakebodom"
PNBLACKLIST[core-image-weston] = "not buildable with lakebodom"
```
